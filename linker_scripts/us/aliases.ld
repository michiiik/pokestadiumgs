/* Descriptive compatibility names are aliases only; owners remain
 * address-stable until their C implementations are byte-matched.
 *
 * This file is hand-written and tracked outside the splat-generated
 * pokestadiumgs.ld so a re-split does not silently drop it (splat rewrites
 * that file from scratch on every `splat split`). It is linked in via an
 * extra `-T` script from the Makefile, the same way hardware_regs.ld,
 * undefined_syms.ld, and the other hand-written scripts are.
 */
Audio_ThreadEntry = Audio_ThreadMain;
/* Fragment 79 residual planning, record queries, and state snapshots. */
func_8414D348 = BattleEffects_PlanResidualDamage;
func_841555B4 = BattleRecord_HasPoweredMoveOfType;
func_8415565C = BattleRecord_HasMove;
func_84155750 = BattleState_PushSnapshot;
/* Fragment 79 calculated/shared HP and amount planning. */
func_8414DB14 = BattleEffects_AddMoveTypeResponse;
func_8414CA80 = BattleEffects_PlanCalculatedRecovery;
func_8414CE08 = BattleEffects_PlanSharedHP;
func_8414EB90 = BattleEffects_ApplyOpposingByteWeight;
func_8414ECE0 = BattleEffects_HalveAmountsForStatus;
/* Fragment 79 side-indexed effect bookkeeping. */
func_8414D910 = BattleEffects_CopyOpposingMove;
func_8414E224 = BattleEffects_SetOpposingAmountFromHP;
func_8414E508 = BattleEffects_ClearInsufficientAmount;
func_8414E5B0 = BattleEffects_DoubleConditionalScale;
func_8414E7D8 = BattleEffects_DoubleScaleForIncomingAmount;
/* Fragment 7 profile-entry validation and compaction. */
func_8300B54C = Fragment7_ValidateProfileEntries;
/* Fragment 7 rule swapping, retained no-op, and profile loading. */
func_8300AC8C = Fragment7_SwapRuleRecords;
func_8300B260 = Fragment7_TeamBankNoOp;
func_8300B8AC = Fragment7_LoadProfileBank;
/* Fragment 4 resource lifecycle and transition owners retain their ABI labels. */
func_81804720 = WidgetResources_Release;
func_818048A4 = WidgetDefinitions_Initialize;
func_81804A2C = WidgetState_AdvanceTransition;
func_81804B74 = WidgetResources_UseTransitionWeight;
func_81800A90 = Gfx_SetupOrthoProjection;
GbSave_GetMapObjectPtr = GbSave_GetMapObject;
/* Fragment 4 state construction and rectangle/resource drawing. */
func_81804954 = WidgetState_Initialize;
func_81805308 = WidgetDefinitions_Draw;
func_818057D0 = WidgetResources_DrawRecords;
/* Selection flags, rendering and the explicit state-aware reset interface. */
func_81803C9C = WidgetSelection_ResetToDefault;
func_81805428 = WidgetSelection_ResetFlaggedVariant;
func_8180567C = WidgetResources_DrawSelection;
/* func_800195C0 reads and writes this same byte in the original assembly. */
Audio_AiHdwrBugFlag = D_8008FAA0;
/* Preserve address-keyed rectangle calls alongside the verified narrow API. */
func_80044270 = GfxRect_DrawTextured;
/* JPEG byte-stuffing state occupies the second byte of the existing flag slot. */
Jpeg_LastByteWasFF = D_800D1218 + 1;
/* Coordinate callback: structured access view of the existing scalar/data label.
 * This alias allocates no storage and preserves the original overlapping view. */
D_82E06138_view = D_82E06138;
/* Original data name aliases the counter's C-owned data slot. */
D_87F112A0 = fragments_64_fragment64_32F2C0;
Audio_RequestEvent = Audio_RequestIfChanged;
func_8005805C = GbSave_IdentifyFormat;
func_8005A228 = GbTower_PollPortState;
func_8005ADD8 = GbTower_StartPortSession;
func_8410F6AC = BattleAnim_ModelDispatch_148;
func_8412A9F4 = BattleAnim_Table_84185F10_009;
func_8413005C = BattleAnim_Table_84186004_050;
func_84131538 = BattleAnim_Table_84186004_082;
func_84115E28 = BattleAnim_Dispatch_107;
func_8412A934 = BattleAnim_Table_84185F10_008;
func_8412BFEC = BattleAnim_Table_84185F10_021;
func_8412D20C = BattleAnim_Table_84185F10_036;
func_84130B40 = BattleAnim_Table_84186004_068;
func_84113D7C = BattleAnim_Dispatch_218;
func_8412D06C = BattleAnim_Table_84185F10_035;
func_8003F3BC = ModelAnim_SetEventTrack;
func_8411D594 = BattleAnim_Dispatch_246;
func_8412D8C8 = BattleAnim_Table_84185F10_042;
func_8412E94C = BattleAnim_Table_84186004_000;
func_84110910 = BattleAnim_ModelDispatch_184;
func_84115FAC = BattleAnim_Dispatch_057;
func_84115A64 = BattleAnim_Dispatch_051;
func_8003AB68 = Geo_NodeBackground;
func_8412DBC0 = BattleAnim_Table_84185F10_045;
func_8412EFFC = BattleAnim_Table_84186004_005;
func_8003ABFC = Geo_NodeClearDepth;
func_861098CC = fragment49_main;
func_84130CE8 = BattleAnim_Table_84186004_072;
func_80040A9C = geo_layout_cmd_create_display_list_matrix;
func_8412C870 = BattleAnim_Table_84185F10_029;
func_8412DD0C = BattleAnim_Table_84185F10_048;
func_84129D8C = BattleAnim_Table_84185F10_000;
func_84130284 = BattleAnim_Table_84186004_053;
func_8410FB0C = BattleAnim_ModelDispatch_204;
func_8003FC8C = geo_layout_cmd_return;
func_80040D9C = geo_layout_cmd_set_node_flag4;
func_80040244 = geo_layout_cmd_create_light;
func_84110860 = BattleAnim_ModelDispatch_191;
func_841109FC = BattleAnim_ModelDispatch_113;
func_8410F1A8 = BattleAnim_ModelDispatch_127;
func_82C04880 = fragment83_main;
func_8412A300 = BattleAnim_Table_84185F10_004;
func_8003A440 = Geo_NodeReference;
func_8003A9CC = Geo_NodeOrtho;
func_8003C080 = Geo_NodeDisplayList;
func_841312E8 = BattleAnim_Table_84186004_080;
func_84110A98 = BattleAnim_ModelDispatch_141;
func_8411B3B8 = BattleAnim_Dispatch_080;
func_841155E8 = BattleAnim_Dispatch_044;
func_8411A4AC = BattleAnim_Dispatch_037;
func_8411AE08 = BattleAnim_Dispatch_099;
func_8411D2E4 = BattleAnim_Dispatch_211;
func_8412CB00 = BattleAnim_Table_84185F10_031;
func_8412F044 = BattleAnim_Table_84186004_006;
func_84116138 = BattleAnim_Dispatch_058;
func_8412E38C = BattleAnim_Table_84185FDC_002;
func_8412B51C = BattleAnim_Table_84185F10_015;
func_8412F208 = BattleAnim_Table_84186004_009;
func_80037E9C = GeoNode_CreateContainer;
func_80032600 = GbAudio_RenderPulse2;
func_841639D0 = FourStreamTrail_Init;
func_84163B4C = FourStreamTrail_Start;
func_84163E60 = FourStreamTrail_UpdateNodeChain;
func_84164280 = FourStreamTrail_Draw;
func_841647D0 = OwnerLinkedFourStream_Init;
func_84164924 = OwnerLinkedFourStream_Start;
func_84164C28 = OwnerLinkedFourStream_UpdateNodeChain;

/* Particle callback defaults: scale and RGBA fields in the shared block. */
D_80128C58 = D_80128C54 + 0x4;
D_80128C5C = D_80128C54 + 0x8;

/* Attachment scales retain their original addresses inside this C data block. */
D_86409C4C = fragments_52_fragment52_285F60 + 0xC;
D_86409C50 = fragments_52_fragment52_285F60 + 0x10;

/* Fragment16 fade-state fields retain their original addresses inside the
 * C-owned data block (func_82000794's mode/counter/alpha words; the three
 * still-asm fade users and the in-file C externs keep these spellings). */
D_82001EA0 = fragments_16_fragment16_code;
D_82001EA2 = fragments_16_fragment16_code + 0x2;
D_82001EA4 = fragments_16_fragment16_code + 0x4;
D_82001EA6 = fragments_16_fragment16_code + 0x6;
D_82001EA8 = fragments_16_fragment16_code + 0x8;
D_82001EAA = fragments_16_fragment16_code + 0xA;
D_82001EAC = fragments_16_fragment16_code + 0xC;
func_87D00020 = fragment65_main;
func_8F2007B4 = fragment70_main;
func_8F0007E8 = fragment68_main;
func_8F50086C = fragment73_main;
func_8FA01830 = fragment75_main;
func_80007A84 = StageFade_Start;
func_80008734 = BgStage_RunUntilCondition;
func_800087E8 = BgStage_WaitForCondition;
func_800088DC = BgStage_DrawFrame;
func_800080E0 = StageLoader_BeginFrame;
func_800082E0 = StageContext_Allocate;
func_80007870 = StageFade_Update;
func_80007E6C = StageLoader_SetupFrame;
func_80006F70 = Gfx_SetScissorRect;
func_80007328 = GfxImage_SetRenderTarget;
func_80007444 = GfxImage_FillRectangle;
func_8000766C = GfxImage_ClearDepthRectangle;
func_80008E30 = TextRenderer_DrawString;
func_80009138 = TextRenderer_QueuePersistentString;
func_80009384 = crash_screen_draw_rect;
func_8000948C = crash_screen_draw_glyph;
func_80009940 = crash_screen_draw;
func_80009F80 = crash_screen_printf_with_bg;
func_8000BC90 = Jpeg_DecodeMcus;
func_8000BEB8 = Jpeg_DecodeBlock;
func_8000C054 = Jpeg_DecodeHuffmanSymbol;
func_8000C190 = Jpeg_ReadBits;
func_82000C00 = Fragment16_DrawFadingOverlay;
func_82000FB0 = Fragment16_DrawVersionStamp;
func_820010BC = Fragment16_DrawSelectionList;
func_820011D8 = Fragment16_DrawSelectionPopup;
func_82001590 = Fragment16_HandleSelectionInput;
func_820016EC = Fragment16_HandleListInput;
func_82001ADC = fragment16_main;
func_81301030 = Fragment14_InitSelectionPreview;
func_813011B8 = Fragment14_InitSelectedController;
func_813013C0 = Fragment14_InitSelectionPanelMode2;
func_81301448 = Fragment14_InitSelectionPanelMode1;
func_81300F7C = Fragment14_InitSelectionAdvance;
func_813012C0 = Fragment14_InitSelectionPanelMode0;
func_8130015C = Fragment14_UpdateTitleText;
func_8130176C = Fragment14_UpdateSelectionPreview;
func_8130183C = Fragment14_UpdateSelectionPage;
func_81300390 = Fragment14_ConfigureControllerSelection;
func_813019C8 = Fragment14_UpdateSelectionCommit;
func_813018FC = Fragment14_UpdateControllerDialog;
func_81301F64 = Fragment14_EnterSelectionState;
func_813021B4 = Fragment14_DrawSelectionState;
func_81300730 = Fragment14_AdvanceSelectionSlot;
func_81300B50 = Fragment14_GetSelectionExitStatus;
func_81301548 = Fragment14_UpdateSlotDialog;
func_81302920 = Fragment14_PreloadSelectionResource;
func_81304CE0 = Fragment14_InterpolatePanelRectangle;
func_81304E80 = Fragment14_UpdatePanelInput;
func_813050D0 = Fragment14_UpdatePanelState;
func_813054F4 = Fragment14_DrawSelectionPanel;
func_813051B8 = Fragment14_DrawPanelContents;
func_8130559C = Fragment14_GetPanelResult;
func_81306178 = Fragment14_ConfirmGridSelection;
func_8130687C = Fragment14_UpdateGridCursorStep;
func_813069BC = Fragment14_UpdateGridState;
func_81306E90 = Fragment14_BeginGridClose;
func_81305AD0 = Fragment14_ComputeGridCursorPosition;
func_813063CC = Fragment14_ScrollGridForward;
func_81306B64 = Fragment14_ResetGrid;
func_81305780 = Fragment14_ComputeGridRectangles;
func_82405934 = Fragment13_UpdateSceneLightNode;
func_824059E4 = Fragment13_UpdateSceneDirectionalLightNode;
func_82405A84 = Fragment13_UpdateClockHourHand;
func_82405B24 = Fragment13_UpdateClockMinuteHand;
func_824048F0 = Fragment13_InitGroupedList;
func_82405F8C = Fragment13_StepVectorToward;
func_82407170 = Fragment13_FindNearestGroup;
func_82404990 = Fragment13_GetGroupedListItem;
func_82404AE8 = Fragment13_HasSelectionChanges;
func_82404B6C = Fragment13_LoadGroupSelections;
func_82404E50 = Fragment13_UpdateGroupTransition;
func_824049D0 = Fragment13_InitAvailableGroupedList;
func_82404C78 = Fragment13_ApplyGroupSelections;
func_82405C0C = Fragment13_ResetGroupCamera;
func_82405D38 = Fragment13_InitGroupState;
func_82405244 = Fragment13_LerpRgb;
func_82407228 = Fragment13_SyncSceneSelections;
func_82402A14 = Fragment13_GetGroupedItemLabel;
func_8240182C = Fragment13_DrawPanelCorners;
func_82401570 = Fragment13_DrawTexturedPanelBorder;
func_82401A28 = Fragment13_DrawColoredPanelFill;
func_82400BD0 = Fragment13_DrawClippedTextureRect;
func_824046A4 = Fragment13_DrawConfirmationDialog;
func_82404440 = Fragment13_HandleConfirmationInput;
/* Lighting iteration also uses this switch table as an end marker. */
PROVIDE(jtbl_82409058 = fragment13_RODATA_START + 0x158);
func_824045B4 = Fragment13_UpdateConfirmationDialog;
func_82406A78 = Fragment13_UpdateGroupScene;
func_865038A8 = Fragment53_ApplyPendingPrimaryAnimation;
func_86501FA0 = Fragment53_UpdateTrajectoryPosition;
func_8650A278 = Fragment53_RunSceneTransition;
func_86501D6C = Fragment53_CountTrajectorySamplesInRange;
func_82406880 = Fragment13_UpdateGroupListTransition;
func_82406E14 = Fragment13_DrawGroupScene;
func_824070E4 = Fragment13_GetInterpolatedListPosition;
func_824020B4 = Fragment13_DrawSelectionFooter;
func_82402904 = Fragment13_DrawSelectionHeader;
func_8650863C = Fragment53_UpdateTimedSecondaryAnimation;
func_86508780 = Fragment53_UpdateSecondaryAnimation;
func_8650455C = Fragment53_UpdateActorModelHeights;
func_86508484 = Fragment53_InitActorModels;
func_865082C8 = Fragment53_DrawSceneFrame;
func_8650A3E4 = Fragment53_RunScene;
func_86502958 = Fragment53_InitActorStateAndOrder;
func_86508B20 = Fragment53_UpdateStartState;
func_86502720 = Fragment53_InitRoundState;
func_86503938 = Fragment53_UpdatePrimaryAnimationState;
func_86501EA0 = Fragment53_SelectDifficultyOffset;
func_8AF02B88 = Fragment44_ShiftActiveScrollRecords;
func_8AF02FC8 = Fragment44_StepScrollUp;
func_8AF0304C = Fragment44_StepScrollDown;
func_8AF03104 = Fragment44_AlignAndStepScrollUp;
func_8AF03198 = Fragment44_AlignAndStepScrollDown;
func_8AF02684 = Fragment44_CullScrollRecordsAbove;
func_8AF02750 = Fragment44_CullScrollRecordsBelow;
func_8AF02A34 = Fragment44_PrepareTrailingScrollRow;
func_8AF02410 = Fragment44_RenderScrollRecord;
func_8AF02C28 = Fragment44_InitializeScrollList;
func_8003C9B8 = GeoRender_FindAnchorPosition;
func_80038894 = GeoNode_CreateModelPart;
func_8003C6B8 = Geo_RenderRootNode;
func_8003D0C8 = GeoRender_SetPrimitiveColor;
func_80037F40 = GeoNode_CreateCamera;
func_8003D55C = GeoRender_EnableTextureGeneration;
func_80040E80 = process_geo_layout;
func_8003A2C8 = Geo_ProcessNodeChildren;
func_8003A960 = Geo_NodeModelPartRoot;
func_8003AA58 = Geo_NodePerspective;
func_80040F60 = Model_AdjustTextureColors;
func_80024D6C = Audio_GetOrCacheResourceId;
func_80025EB0 = Audio_RenderNextBuffer;
func_800279C4 = Audio_PlayDefaultSound;
func_8002A1FC = Audio_ResetQueueAndBitmap;
func_800390D8 = GeoRender_CommitMatrix;
func_80039158 = GeoRender_SetMatrix;
func_80039204 = GeoRender_PushMultipliedMatrix;
func_800392B8 = GeoRender_PushScaledMatrix;
func_80025B54 = Audio_SetPreset;
func_8002B490 = Audio_RequestSlot;
func_8003B044 = Geo_NodeAmbientLight;
func_8003D888 = GeoRender_SubmitMaterial;
func_8002596C = Audio_ApplyCommandPreset;
func_800341C8 = AudioSeq_ReadWordParameter;
func_80035174 = Audio_ThreadMain;
func_800371B4 = Camera_ComputeEyeFromAngles;
func_8003B218 = Geo_NodeUpdateLights;
func_8003C848 = Geo_ProcessCallbacks;
func_8003B48C = Geo_NodeCullDistance;
func_8003B534 = Geo_NodeSwitchCase;
func_800382E4 = GeoNode_CreateLight;
func_8003A370 = Geo_PrepareShadowChildren;
func_8003AC8C = Geo_NodeFog;
func_8003ADA4 = Geo_NodeLight;
func_8003B6D8 = Geo_NodeAnimatedPart;
func_8003B9F0 = Geo_PrepareAnimatedPart;
func_8003CC14 = GeoRender_SetRenderMode;
func_8003CFB8 = GeoRender_SetFogColor;
func_8003CD84 = GeoRender_ApplyMaterialState;
func_8003D270 = GeoRender_BindTexture;
func_8003D70C = GeoRender_SelectMaterialSlot;
func_8003DB38 = GeoRender_InitMaterialState;
func_8003ED18 = ModelAnim_BeginEventContext;
func_8003F210 = ModelAnim_SetAnimation;
func_8003F2C4 = ModelAnim_SetResourceAnimation;
func_8003F874 = PokeIcon_RequestBackgroundForObject;
func_80037B08 = Color_AdjustRGB5551;
func_80041BF0 = PokeIcon_InitLoadContext;
func_80041C98 = PokeIcon_AllocLoadContext;
func_80041D84 = PokeIcon_AllocSpecialModelContext;
func_80037C80 = Color_AdjustRGBA8;
func_8003DD2C = GeoRender_FlushMaterialSlots;
func_8003F9AC = SceneObject_SetModelVariant;
func_80041548 = Fragment_ProcessGeoLayout;
func_80041E2C = PokeIcon_InitResourceArchives;
func_80042484 = Model_FindLowestTextureAddress;
func_800425C0 = PokeIcon_ApplyResourceLoadResult;
func_800412B0 = Fragment_LoadResourceFromRomRange;
func_80041780 = PokeIcon_LoadResourceList;
func_800284C0 = Audio_LookupScaledRatio;
func_80033488 = GbAudio_UpdateChannelIfEnabled;
func_800355E4 = Audio_RequestIfChanged;
func_8002730C = Audio_FindEnabledChannel;
func_800273B4 = Audio_FindLowestPriorityChannel;
func_80033E34 = GbAudio_ReadChannelParameters;
func_80034C58 = GbAudio_StartSequenceChannel;
func_80034F30 = GbAudio_GetActiveChannelMask;
func_800319D0 = GbAudio_QueueRegisterWrite;
func_80033890 = GbAudio_UpdateNoiseRegisters;
func_80034D00 = GbAudio_QueueChannelReset;
func_80034ABC = GbAudio_StartSequence;
func_80035068 = Audio_ReadRomBlocking;
func_800334C0 = GbAudio_UpdateSquare1Registers;
func_80033670 = GbAudio_UpdateSquare2Registers;
func_80026BB4 = Audio_DebugSampleHistogram;
func_80034118 = GbAudio_ReadPackedChannelParameters;
func_80025F84 = Audio_InitializeBufferMemory;
func_80026E08 = Audio_ConfigureEventChannel;
func_80026F44 = Audio_SetupEventVoice;
func_800271DC = Audio_SelectEventChannel;
func_8002702C = Audio_UpdateEventVoiceParameters;
func_8002397C = Audio_GetSpeciesMaskBit;
func_800354B4 = Audio_SetModeBlocking;
func_800266F8 = Audio_GetEventConfigIndex;
func_800262F0 = Audio_ResetCategoryState;
func_80026C80 = Audio_ProcessChannelEvent;
func_8003691C = MtxF_SetOrthonormalBasis;
func_80035FFC = MtxF_SetRotationTranslation;
func_8003614C = MtxF_SetRotationTranslationF;
func_80036284 = MtxF_SetRotationAndTransformTranslation;
func_80036430 = MtxF_SetRotationScaleTranslation;
func_800365B8 = MtxF_SetRotationAndScaledTranslation;
func_80035D14 = MtxF_SetLookAt;
func_80036F0C = MtxF_ToFixed;
func_8003A7F4 = Geo_NodeModelRoot;
func_8003C10C = Geo_NodeShadowTexture;
func_8003BCB4 = Geo_NodeModelPart;
func_80033CA0 = GbAudio_ProcessChannelStream;
func_80032F0C = GbAudio_ResetState;
func_80028340 = Audio_UpdateDeferredSounds;
func_8002818C = Audio_QueueDeferredSound;
func_80031638 = Audio_UpdateCommandQueue;
func_80027BD4 = Audio_BuildAndDispatchSoundEvent;
func_8003946C = GeoOverlay_BuildFadeQuad;
func_8003C390 = Geo_NodeShadow;
func_8004300C = ModelPreview_TryCopySelection;
func_80043450 = ModelPreview_UpdateAutoRotation;
func_80042C68 = ModelPreview_Create;
func_80042D8C = ModelPreview_RefreshSelection;
func_80042EB8 = ModelPreview_SetSelection;
func_800430B4 = ModelPreview_ApplyEditControls;
func_8006179C = Pokemon_GetDVForStat;
func_8006183C = Pokemon_CalculateStat;
func_80061ADC = Pokemon_StatExpForTarget;
func_80061ED0 = Pokemon_LevelFromExp;
func_80060AC8 = GbText_DecodeCharForMode;
func_80060B74 = GbText_EncodeCharForMode;
func_80061D8C = Pokemon_LevelFromExpWithHint;
func_80062390 = Deck_ReadEntries;
func_8006249C = Deck_WriteEntries;
func_80062808 = Pokemon_ValidateSpeciesForGbPort;
func_80062884 = Pokemon_ValidateMovesForGbPort;
func_80062614 = GbMail_ImportRecord;
func_80061940 = Pokemon_ClampCurrentStat;
func_80064728 = Pokemon_GetDisplaySpecies;
func_80063A8C = Pokemon_FindEvolutionMethod;
func_80063D54 = Pokemon_CanLearnGen1Machine;
func_80063838 = Pokemon_GetBaseStat;
func_800640F8 = Pokemon_GetMoveLearnLevelForVersion;
func_800641CC = Pokemon_IsSmeargleMoveAllowed;
func_82D00108 = SpeciesMask_Invert_fragment82;
func_82D001C0 = MenuSelection_StepSkipping_fragment82;
func_82D00704 = DeckEntry_InitDefaults_fragment82;
func_82D00784 = MenuName_HasNonspace_fragment82;
func_82D0034C = DeckMenu_LoadEntries_fragment82;
func_82D007CC = DeckName_CommitEdit_fragment82;
func_82D00BB4 = DeckMenu_HandleSettingsInput_fragment82;
func_82D0183C = DeckMenu_EditBoundedValue_fragment82;
func_82D026C4 = DeckMenu_DispatchState_fragment82;
func_82D0213C = DeckMenu_SwapEntries_fragment82;
func_84200038 = Species_HasType_fragment80;
func_842000EC = Ratio_ScaleToByte_fragment80;
func_842001BC = TypeScore_AddCoefficient0D_fragment80;
func_84200258 = TypeScore_AddCoefficient0E_fragment80;
func_842002F4 = TypeScore_AddCoefficient0F_fragment80;
func_84201170 = MoveDamage_LoadStats_fragment80;
func_84201234 = MoveDamage_ComputeBase_fragment80;
func_8420138C = MoveDamage_ApplyTypeFactors_fragment80;
func_8420151C = MoveDamage_ApplyEffect_fragment80;
func_84201728 = MoveAccuracy_AdjustLevelDifference_fragment80;
func_84201408 = MoveDamage_ApplyPowerEffect_fragment80;
func_842018A8 = TeamCandidates_Reset_fragment80;
func_84202020 = TeamScores_Rank_fragment80;
func_84202198 = TeamCandidates_VisitMembers_fragment80;
func_8420300C = TeamCandidate_PromoteChoice_fragment80;
func_842018FC = MoveEffect_UsesDamageSimulation_fragment80;
func_84201DDC = TeamMember_SumMatchupValues_fragment80;
func_84202EE4 = TeamCandidate_SelectLead_fragment80;
func_842024CC = TeamCandidate_ApplySharedWeakness_fragment80;
func_84202798 = TeamCandidates_InsertRanked_fragment80;
func_842017D0 = TeamParameters_Load_fragment80;
func_84203090 = TeamRoster_ApplyCandidateOrder_fragment80;
func_84201AEC = TeamMember_ComputeMatchupValue_fragment80;
func_842022F0 = TeamCandidate_PassesRules_fragment80;
func_84300350 = ByteList_RemoveFirst_fragment81;
func_843005B8 = MoveRules_MatchesEffect_fragment81;
func_84301AEC = Pokemon_ShuffleMoves_fragment81;
func_8430022C = ByteList_ChooseRandom_fragment81;
func_8430049C = MoveLists_ApplySelectionWeights_fragment81;
MoveLists_ApplySpeciesWeights_fragment81 = MoveLists_ApplySelectionWeights_fragment81;
func_84300CC0 = MoveSelection_ChooseFirst_fragment81;
func_84301094 = MoveSelection_ChooseSecond_fragment81;
func_84301490 = MoveSelection_ChooseFourth_fragment81;
func_84300020 = HeldItem_ForSpecies_fragment81;
func_843000C8 = HeldItem_ForMoveType_fragment81;
func_8430188C = MovePools_ClassifyLearnable_fragment81;
func_843006B0 = HeldItem_IsRedundantForType_fragment81;
func_84300A54 = SpeciesCandidates_AddType_fragment81;
func_84300B30 = SpeciesCandidates_PopulateTypes_fragment81;
func_84301CB4 = TeamRoster_Shuffle_fragment81;
func_844000C4 = ByteList_ChooseRandom_fragment86;
func_84400348 = ByteList_FindIndex_fragment86;
func_844006F8 = MoveSelection_AssignThree_fragment86;
func_844007D8 = Pokemon_GenerateLevel100_fragment86;
func_844003E4 = MovePools_ClassifyCandidate_fragment86;
func_84400528 = MoveSelection_ChooseSlot_fragment86;
func_844008E4 = Teams_GenerateLevel100_fragment86;
func_81B00020 = RoomDecor_SetBed_fragment87;
func_81B000B4 = RoomDecor_SetCarpet_fragment87;
func_81B0019C = RoomDecor_SetPlant_fragment87;
func_81B00230 = RoomDecor_SetPoster_fragment87;
func_81B00CA0 = RoomDecor_RestoreSavedView_fragment87;
func_81B00E58 = RoomDecor_SetByCategory_fragment87;
func_81B00788 = RoomDecor_RebuildObjects_fragment87;
func_81C00050 = MysteryGift_RollItemIndex_fragment88;
func_81C004E4 = MysteryGift_SelectReward_fragment88;
func_81C00174 = MysteryGift_RollDecorationIndex_fragment88;
func_81C00408 = MysteryGift_ReceiveReward_fragment88;
func_81C0034C = MysteryGift_TryPrepareSelections_fragment88;
func_81C00584 = MysteryGift_BuildTeam_fragment88;
func_8822D140 = LabPC_SwapBytePairContents;
func_8822D180 = LabPC_SortBytePairContents;
func_8822D238 = LabPC_CompareRankedBytePairs;
func_8822D2F4 = LabPC_FindPrimaryByteOrderIndex;
func_8822D3A8 = LabPC_FindAlternateByteOrderIndex;
func_8822DB28 = LabPC_DestroyOwnedLists;
func_8822D7B4 = LabPC_UpdateSortDialogInput;
func_8822D89C = LabPC_CreateSortDialog;
func_8822DC84 = LabPC_UpdateListChoiceDialogInput;
func_8822DEBC = LabPC_DrawListChoiceDialog;
func_8822D45C = LabPC_ApplyBytePairSortOrder;
func_8823145C = LabPC_DrawInColumnSwapHighlights;
func_88231540 = LabPC_DrawInColumnSwapEntries;
func_882316D0 = LabPC_DrawCrossColumnSwapHighlights;
func_88231784 = LabPC_DrawCrossColumnSwapEntries;
func_882318F0 = LabPC_DrawQuantityTransferHighlights;
func_882319A4 = LabPC_DrawQuantityTransferEntries;
func_88231B20 = LabPC_DrawListSwapHighlights;
func_88231C04 = LabPC_DrawListSwapEntries;
func_88231D70 = LabPC_DrawCrossColumnListSwapHighlights;
func_88231E24 = LabPC_DrawCrossColumnListSwapEntries;
func_88231F60 = LabPC_DrawCrossColumnListMoveHighlights;
func_88232014 = LabPC_DrawCrossColumnListMoveEntry;
func_88232130 = LabPC_DrawListFadeHighlights;
func_882321F8 = LabPC_DrawListFadeEntry;
func_882322F0 = LabPC_MarkUnflaggedListEntries;
func_8823233C = LabPC_DrawListExchangeHighlights;
func_8823243C = LabPC_SetListExchangeAlphaCompare;
func_882324D4 = LabPC_DrawListExchangeEntries;
func_882328C0 = LabPC_DrawFieldSwapHighlights;
func_882329A4 = LabPC_DrawFieldSwapLabels;
func_88232B90 = LabPC_DrawRecordTransferHighlights;
func_88232C68 = LabPC_DrawRecordTransferEntries;
func_88232EC8 = LabPC_DrawMoveFieldHighlight;
func_88232F88 = LabPC_DrawMoveFieldValue;
func_88233040 = LabPC_StartMoveFieldAnimation;
func_882331D8 = LabPC_DrawStatChangeHighlights;
func_88233330 = LabPC_DrawStatChangeValues;
func_882330E0 = LabPC_FinishStatChangeAnimation;
func_88233484 = LabPC_StartStatChangeAnimation;
func_88902E8C = LabPC_FindLevelUpEvolution;
func_88902C3C = LabPC_FormatColoredMoveName;
func_889030D8 = LabPC_FindFireStoneEvolution;
func_88903150 = LabPC_FindWaterStoneEvolution;
func_889031A4 = LabPC_FindLeafStoneEvolution;
func_889033FC = LabPC_DrawSelectableTextList;
func_889034DC = LabPC_InitTwoChoiceDialog;
func_88903B2C = LabPC_CloseMessageDialog;
func_88903C50 = LabPC_OpenMessageDialog;
func_889035FC = LabPC_DrawMoveDetails;
func_88900030 = LabPC_InitEvolutionView;
func_889027A4 = LabPC_OpenEvolutionView;
func_8005F808 = GbSave_AccessEventFlag;
func_8005FA1C = GbSave_GetRoomDecorations;
func_8005FAB4 = GbSave_GetSavedMapX;
func_8005FB40 = GbSave_GetSavedMapY;
func_8005FD24 = GbSave_GetRoomSpriteIds;
func_8005FC7C = GbSave_SetRoomMapBlock;
func_8005FDB0 = GbSave_SetMapObjectState;
func_8005FE58 = GbSave_GetMapActor;
func_8005FF0C = GbSave_GetMapObject;
func_8005FFB4 = GbSave_GetRoomDecoration;
func_8005892C = GbSave_WriteGen1SaveBlock;
func_8005BF28 = GbSave_GetGen1BoxCount;
func_8005E12C = GbSave_IsGiftTrainerUnrecorded;
func_800601A4 = GbSave_GetUnownDexEntry;
func_8005A92C = GbSave_ReadAuxiliaryStatus;
func_8005BFA8 = GbSave_GetBoxCount;
func_8005C2B4 = GbSave_SetGen1ItemPair;
func_8005F5D4 = GbSave_SetRelativeRtcTime;
func_80058880 = GbSave_ReadGiftDataAndSyncFlags;
func_8005B280 = GbSave_GetGen2BoxBuffer;
func_889007A0 = LabPC_HandleChoiceInput;
func_88900B08 = LabPC_OpenChoiceWindow;
func_88900C78 = LabPC_HandleMovePaneInput;
func_8005C9E0 = GbSave_IsRecordTypeAvailable;
func_8005CAA4 = GbSave_GetRecordCapacity;
func_8005CBA0 = GbSave_GetRecordSize;
func_8006092C = GbSave_GetGen2HeaderFlag80;
func_8005BBD4 = GbSave_ReadGen2BoxPokemon;
func_8005BD4C = GbSave_WriteGen1BoxPokemon;
func_8005BE08 = GbSave_WriteGen2BoxPokemon;
func_8005BA88 = GbSave_ReadGen1BoxPokemon;
func_8005CCD8 = GbSave_GetGsRecordCount;
func_8005CDDC = GbSave_GetCrystalRecordCount;
func_8005D698 = GbSave_ReadRecord;
func_8005D778 = GbSave_WriteRecord;
func_8005C41C = GbSave_ClampInventoryPacket;
func_8005D194 = GbSave_TruncateCrystalRecordCount;
func_8005D4FC = GbSave_IncrementCrystalRecordCount;
func_8005EF78 = GbSave_WriteGen2BoxName;
func_8005B778 = GbSave_WriteGen1PartyPokemon;
func_8005A174 = GbSave_ResetPortCache;
func_8005F110 = GbSave_ResetPortState;
func_800564BC = GbPak_SelectRamBank;
func_80056870 = GbPak_ReadIdAndDetectRam;
func_80056F7C = GbPak_InitializeCartridge;
func_800574E0 = GbPak_ReadClock;
func_80057640 = GbPak_WriteClock;
func_80056390 = GbPak_EnableRamAccess;
func_80056C98 = GbPak_InitializePorts;
func_8005655C = GbPak_ReadWriteRam;
func_8005777C = GbPak_PollConnection;
func_80002178 = Memmap_SetSegments;
func_84165510 = OwnerAnchoredFourStream_Init;
func_84165670 = OwnerAnchoredFourStream_Start;
func_841659A0 = OwnerAnchoredFourStream_UpdateNodeChain;
func_84166130 = TrailEffectPool_Init;
func_84166270 = TrailEffectPool_Start;
func_8416691C = TrailEffectPool_IsComplete;
func_84166F60 = DoubleTextureTrail_InitPool;
func_841670A8 = DoubleTextureTrail_Spawn;
func_841674C0 = DoubleTextureTrail_Update;
func_841677C4 = DoubleTextureTrail_UpdateAll;
func_84167864 = DoubleTextureTrail_DrawStrips;
func_84168000 = DoubleTextureTrail_DrawAll;
func_84168540 = BattleAnim_SixSlotTrail_ResetPool;
func_84168680 = BattleAnim_SixSlotTrail_Spawn;
func_84169BA8 = AuxiliaryEffect_Alloc;
func_84169C74 = AuxiliaryEffect_Spawn;
func_84169DBC = AuxiliaryEffect_Update;
func_84169F18 = AuxiliaryEffect_DrawOne;
func_8416A050 = AuxiliaryEffect_Draw;
func_84168CA4 = BattleAnim_SixSlotTrail_UpdateSlot;
func_84169040 = BattleAnim_SixSlotTrail_UpdateAll;
func_81804FD0 = WidgetState_Update;
func_81804BC8 = WidgetState_RefreshTransitionStatus;
func_81801FA0 = WidgetTexture_GetDescriptor;
func_81802168 = WidgetText_GetString;
func_818021B4 = WidgetText_GetBufferedString;
func_81803BB8 = WidgetSelection_GetValuePointer;
func_81803BE8 = WidgetSelection_GetMask;
func_81803558 = WidgetText_DrawRecord;
func_81803668 = WidgetText_DrawRecordList;
func_818036D8 = WidgetText_DrawRecordWithSetup;
func_81803720 = WidgetText_DrawRecordListWithSetup;
func_81801FE8 = WidgetTexture_TileViewport;
func_818024B0 = WidgetTexture_SetWeightedColors;
func_81802BAC = WidgetTexture_ApplyStyle;
func_81803964 = WidgetTexture_DrawRecord;
func_81803CD4 = WidgetSelection_WrapAngle;
func_81803D44 = WidgetSelection_AngleDifference;
func_81804534 = WidgetSelection_DrawMarker;
func_81802EA0 = WidgetFrame_DrawNineSlice;
func_83101244 = Fragment6_DrawSelectionControls;
func_83101C80 = Fragment6_InitializeSelectionState;
func_83101400 = Fragment6_DrawAvailableEntryList;
func_83101804 = Fragment6_DrawSavedEntryList;
func_83100DBC = Fragment6_HandleAvailableListScroll;
func_830018B0 = Fragment7_DrawSavedRecordList;
func_83002988 = Fragment7_DrawRecordSummary;
func_83008188 = Fragment7_DrawSelectedRecordView;
func_8300A898 = Fragment7_RunSelectionMenu;
func_83001A3C = Fragment7_DrawFirstRecordListPanel;
func_83001BA4 = Fragment7_DrawSecondRecordListPanel;
func_83008DC0 = Fragment7_SelectSavedRecord;
func_830096B8 = Fragment7_InitializeRecordCollections;
func_83008740 = Fragment7_DrawRecordStatus;
func_83008A68 = Fragment7_SelectTeamRecord;
func_83008BB8 = Fragment7_HandleTeamListScroll;
func_830090D0 = Fragment7_HandleRecordListScroll;
func_830095B8 = Fragment7_SelectOtherRecord;
func_83009BD0 = Fragment7_OpenRecordPanel;
func_830022F0 = Fragment7_HandleTeamGridScroll;
func_830061BC = Fragment7_RefreshRecordCompatibility;
func_83007D40 = Fragment7_DrawSlidingRecordPanel;
func_8300928C = Fragment7_DrawRecordListIndicators;
func_83000CB4 = Fragment7_RefreshCollectionCompatibility;
func_83001000 = Fragment7_LoadTeamVisualResources;
func_8300112C = Fragment7_LoadControllerDeck;
func_83007568 = Fragment7_HandleTeamActions;
func_83007788 = Fragment7_BuildControllerTeam;
func_830078E4 = Fragment7_HandleTeamPartActions;
func_83008494 = Fragment7_HandleRecordActions;
func_83000AA4 = Fragment7_ClassifyHeldItem;
func_830013A8 = Fragment7_DrawModeHeader;
func_83003F40 = Fragment7_DrawProfileRecordRow;
func_83004CBC = Fragment7_DrawTeamListRows;
func_830098A0 = Fragment7_InitializeRecordPanel;
func_83003000 = Fragment7_DrawRuleSelectionList;
func_830025AC = Fragment7_DrawSecondTeamListPanel;
func_83006B48 = Fragment7_HandleBankTransferActions;
func_8300AA58 = Fragment7_InitializeRuleBank;
func_8300AEEC = Fragment7_InitializeTeamBank;
func_8300B284 = Fragment7_LoadTeamBank;
func_8300B330 = Fragment7_InitializeProfileBank;
func_8300ADA4 = Fragment7_SaveRuleBank;
func_8300AE40 = Fragment7_LoadRuleBank;
func_8300B1CC = Fragment7_SaveTeamBank;
func_8300B504 = Fragment7_IsValidProfilePokemon;
func_8300B818 = Fragment7_SaveProfileBank;
func_8300ABCC = Fragment7_RemoveRuleRecord;
func_8300B038 = Fragment7_RemoveTeamRecord;
func_8300B0DC = Fragment7_SwapTeamRecords;
func_8300B468 = Fragment7_RemoveProfileRecord;
func_8300B728 = Fragment7_SwapProfileRecords;

func_84155A44 = BattleMoveState_CopySelectedMoves;
func_8415623C = BattleMoveState_RefreshSelectedMoves;
func_84155BD4 = BattleMoveState_ApplySelectedMoveEffects;

func_8415AC64 = BattleAnim_SetTerrainGridPointValue;
func_8415A9E4 = BattleAnim_InitializeTerrainGrid;
func_8415AD58 = BattleAnim_UpdateTerrainGrid;
func_84159D30 = BattleAnim_BuildTerrainCameraBounds;
func_84159FA8 = BattleAnim_SampleTerrainHeightAndSlope;
func_84156CCC = BattleAnim_StartEffect19Radial20_EmitVariantD;
func_8415782C = BattleAnim_StartEffect98Radial20_EmitVariantD;
func_84157ADC = BattleAnim_StartEffect11Trail50Alt_Update;
func_84157CDC = BattleAnim_StartEffect57Trail50_Update;
func_84157128 = BattleAnim_StartEffect7TexturedRibbonSheet_Emit;
func_8415839C = BattleAnim_StartEffect62OwnerLinkedFourStream_Update;
func_84158588 = BattleAnim_StartEffect67OwnerAnchoredFourStream_Init;
func_84158914 = BattleAnim_StartEffect26DoubleTextureTrail_Emit;
func_84158C4C = BattleAnim_StartEffect47SixSlotTrail_Emit;
func_84158F00 = BattleAnim_StartEffect4DoubleTextureTrail_Emit;
func_8415923C = BattleAnim_StartEffect77DoubleTextureTrail_Emit;
func_84159584 = BattleAnim_StartEffect70DoubleTextureTrail_Emit;
func_841597AC = BattleAnim_StartEffect39CombinedTrail_EmitDoubleTexture;
func_84159A50 = BattleAnim_StartEffect39CombinedTrail_EmitSixSlot;
func_84157398 = BattleAnim_StartEffect33Radial20_Emit;
func_8415BBA0 = Strip400_Initialize;
func_8415C644 = Radial20_StartStraight;
func_8415C884 = Radial20_StartYVelocityWave;
func_8415CC74 = Radial20_StartZVelocityWave;
func_8415BD48 = Strip400_Update;
func_8415D074 = Radial20_StartPositionWaves;
func_8415D4C4 = Radial20_UpdateNodes;
func_8415C2E0 = Strip400_Draw;
func_8415DBBC = Radial20_Draw;
func_8415F264 = RippleGrid16_RecomputeNormal;
func_8415F8E8 = RippleGrid16_FillVertex;
func_8415F9A0 = RippleGrid16_Update;
func_8415FC60 = RippleGrid16_BuildViewMatrix;
func_8415FD8C = RippleGrid16_Draw;
func_8415F0D0 = RippleGrid16_Initialize;
func_841605F4 = PhaseGrid16_RecomputeNormal;
func_84160C20 = PhaseGrid16_FillVertex;
func_84160CD8 = PhaseGrid16_Update;
func_84160EEC = PhaseGrid16_BuildViewMatrix;
func_84160250 = PhaseGrid16_AddRipple;
func_841603A0 = PhaseGrid16_Initialize;
func_84161018 = PhaseGrid16_Draw;
func_841614E0 = FlatGrid16_Initialize;
func_84161CF4 = FlatGrid16_FillVertex;
func_84162078 = FlatGrid16_BuildViewMatrix;
func_84162C88 = TexturedRibbonSheet_IsComplete;
func_84161670 = FlatGrid16_RecomputeNormal;
func_84161DAC = FlatGrid16_Update;
func_841621A4 = FlatGrid16_Draw;
func_84162660 = TexturedRibbonSheet_Init;
func_84162798 = TexturedRibbonSheet_Start;
func_84162DE8 = TexturedRibbonSheet_Draw;
func_84155820 = BattleMoveState_RefreshSelectedStats;
func_84155DB4 = BattleMoveState_FindStrongestMove;
func_84155CB8 = BattleMoveState_UpdateMoveSlot;
func_84155AC4 = BattleMoveState_RecordMoveAgainstSlot;
func_841562BC = BattleMoveState_CopyPartyStatToRecord;
func_841502D0 = BattlePlan_ApplyPursuitMultiplier;
func_84152CD8 = BattlePlan_HasOnlyNormalOrFightingMoves;
func_84153780 = BattlePlan_AddConditionCountBonus;
func_84150268 = BattlePlan_UpdateMoveAccuracy;
func_84152600 = BattlePlan_AddStealableItemBonus;
func_84152D6C = BattlePlan_CountHitObstacles;
func_84152E10 = BattlePlan_AddHitObstacleBonus;
func_84151F9C = BattlePlan_AddLeechSeedBonus;
func_8415252C = BattlePlan_AddHealBellBonus;
func_84152EE8 = BattlePlan_AddPerishSongBonus;
func_841537FC = BattlePlan_AddRainDanceBonus;
func_84153930 = BattlePlan_AddSunnyDayBonus;
func_84153B10 = BattlePlan_HasUnfavorableStages;

/* Campaign rename aliases (branch-relative): forward aliases resolve
   old-name externs against included C; reverse aliases resolve our new-name
   references against origin's still-asm definitions. */
func_800052C4 = Sched_HandleRspEvent;
func_8000A080 = profiler_log_worker_time;
func_800162D0 = GbApu_InitSlowCopySlot;
func_8001644C = GbApu_ResetSlotFlags;
func_8004A858 = Ui_DrawGradientQuad;
func_800630F0 = Type_IdToChartIndex;
func_800631B4 = Type_ChartIndexToId;
func_81800A90 = Gfx_SetupOrthoProjection;
func_82800490 = fragment10_main;
func_88000080 = Envelope_Advance;
func_8131001C = MathUtil_Atan2d_fragment14;
func_8840011C = ModelPreview_UpdateAutoRotation_fragment33;
func_88508B10 = TradeCable_UpdateLightWaitPulse;
func_88508CAC = TradeCable_UpdateLightFlashPulse;
func_885096E0 = TradeCable_SpawnBallTrailGhost;
func_87C00D14 = MathUtil_Atan2d_fragment48;
func_86706874 = GeoCallback_OrientToCamera;
func_86900020 = GeoCallback_InitCamera;
func_8FC00218 = Gfx_DrawTexturedFrame16;
func_8410A4F8 = Audio_SetChannelGroupCounts;
func_84120464 = BattleAnim_InitSwayOffset;
func_84124514 = Audio_LookupScaledRatio_fragment79;
func_84149568 = MoveDamage_ComputeBase_fragment79;
func_81600450 = Rect_Contains;
func_816028E4 = Fragment11_SetClippedScissor;
func_816039B0 = Fragment11_DrawThickPanelFrame;
func_81603CD0 = Fragment11_DrawTexturedPanelBorder;
func_816044AC = Fragment11_DrawBorderedPanelFill;
func_8131001C = MathUtil_Atan2d_fragment14;
func_88000080 = Envelope_Advance;
func_8840011C = ModelPreview_UpdateAutoRotation_fragment33;
func_88508B10 = TradeCable_UpdateLightWaitPulse;
func_88508CAC = TradeCable_UpdateLightFlashPulse;
func_885096E0 = TradeCable_SpawnBallTrailGhost;
func_87C00D14 = MathUtil_Atan2d_fragment48;
func_86706874 = GeoCallback_OrientToCamera;
func_86900020 = GeoCallback_InitCamera;
func_8410A4F8 = Audio_SetChannelGroupCounts;
func_84120464 = BattleAnim_InitSwayOffset;
func_84124514 = Audio_LookupScaledRatio_fragment79;
func_84149568 = MoveDamage_ComputeBase_fragment79;
func_8FC00218 = Gfx_DrawTexturedFrame16;
func_84153CB8 = BattlePlan_AddPsychUpBonus;
func_841514F8 = BattlePlan_CountResistingMoveSlots;
func_841515AC = BattlePlan_AddConversionBonus;
func_84151E44 = BattlePlan_AddMimicBonus;
func_8415169C = BattlePlan_AddFlinchBonus;
func_84152980 = BattlePlan_ScoreCurse;
func_84151270 = BattlePlan_AddRampageBonus;
func_84151128 = BattlePlan_ScoreHaze;
func_84150538 = BattlePlan_ScorePoison;
func_841506D0 = BattlePlan_ScoreBurn;
func_84150878 = BattlePlan_ScoreFreeze;
func_841503B0 = BattlePlan_ScoreSleep;
func_841509E0 = BattlePlan_ScoreParalysis;
func_84153028 = BattlePlan_AddSandstormBonus;
func_841531D4 = BattlePlan_ScoreEndure;
func_84150B14 = BattlePlan_ScoreStatIncrease;
func_84150EA4 = BattlePlan_ScoreStatReduction;
func_84153554 = BattlePlan_AddBatonPassBonus;
func_8412F49C = BattleEffect_HealByWeather;
func_841315C4 = BattleCommand_RunSequence;
func_84136CA8 = BattleRecord_AdvanceWriteSlot;
func_84127C88 = BattleDamage_RollCriticalHit;
func_8412D950 = BattleEffect_ClearPartyStatus;
func_82601A84 = RecordNames_LoadFourSlots;
func_82601BB0 = RecordNames_FormatTwoSlots;
func_82601D2C = RecordNames_LoadTwoSlots;
func_82601E70 = RecordNames_LoadSelectedOrDefaultSlots;
func_82601F90 = RecordText_SelectAndMeasure;
func_82601968 = RecordText_CopyUnassignedEntries;
func_82602AC0 = RecordNames_LoadUnassignedFourSlots;
func_82602CF4 = RecordNames_LoadSelectedOrDefaultPair;
func_82603814 = RecordOwners_AnyUnassigned;
func_82602B9C = RecordNames_LoadTwoSlotsOptionalDefaults;
func_826039A0 = RecordSelection_RunPhaseLoop;
func_82600BA0 = RecordSelection_ChooseSortedIndices;
func_82600D38 = RecordSelection_PrepareTwoParties;
func_841118E0 = BattleAnim_AllocateSideObjects;
func_841121CC = BattleAnim_SetAnimationAndFrame;
func_84112648 = BattleAnim_RunObjectCallbacks;
func_8411275C = BattleAnim_LoadModelResource;
func_8410DEB4 = BattleAnim_AdjustCameraDistance;
func_841146D4 = BattleAnim_ApplyAnimationRecord;
func_84116F7C = BattleAnim_BeginMoveAnimation;
func_8411D1A8 = BattleAnim_UpdateTimedEffectSequence;
func_84112B64 = BattleAnim_LoadSpecialModel;
func_84117744 = BattleAnim_UpdateMoveFramesAndCamera;
func_841187E4 = BattleAnim_DispatchAnimationStart;
func_84119AB4 = BattleAnim_UpdateModelEventSequence;
func_841193E0 = BattleAnim_DispatchDelayedCategory;
func_84119CF0 = BattleAnim_InitializeCategorySequence;
func_8410CF80 = BattleAnim_UpdateCameraHeightTarget;
func_84117E94 = BattleAnim_UpdateTimedMoveEvents;
func_841119CC = BattleAnim_SelectCameraPreset;
func_84110C6C = BattleAnim_UpdateCameraFromInput;
func_84110B2C = BattleAnim_UpdateCameraWave;
func_84116BC0 = BattleAnim_ConfigureAnimationCamera;
func_8411BB04 = BattleAnim_InitializePackedModelState;
func_84113590 = BattleAnim_LoadCameraTrackResource;
func_84113658 = BattleAnim_LoadSpeciesCameraPreset;
func_8411A7D8 = BattleAnim_ResetPackedModelState;
func_84111EC4 = BattleAnim_ClearFinishedEventTrack;
func_84111774 = BattleAnim_RunCameraStageCallbacks;
func_841156D0 = BattleAnim_UpdateAscentPhase;
func_8411DAE0 = BattleAnim_UpdateBothSideCallbacks;
func_84112C98 = BattleAnim_RefreshSpeciesModel;
func_82603B20 = TrailEffect_Advance;
func_826040D8 = TrailEffect_Initialize;
func_826042A0 = TrailEffect_DrawAll;
func_82507DC0 = CellularTransition_SeedCells;
func_82507EE8 = CellularTransition_FindEmptyNeighbors;
func_8250850C = CellularTransition_Draw;
func_841153DC = BattleAnim_UpdateTimedFinishPhase;
func_84117AA0 = BattleAnim_DispatchActionFeedback;
func_84115B34 = BattleAnim_UpdateBurrowTransition;
func_8411D7F8 = BattleAnim_InitializeActorFromSide;
func_84118C08 = BattleAnim_RefreshCategoryCamera;
func_841189EC = BattleAnim_DispatchCategoryRecord;
func_841114A8 = BattleAnim_UpdateAudioProjections;
func_8411CD38 = BattleAnim_UpdateSideViewportTransition;
func_84118DD4 = BattleAnim_UpdateCategoryActionTimeline;
func_8411C418 = BattleAnim_UpdateSideTrackViewportTransition;
func_841170A0 = BattleAnim_InitializeCategoryAction;
func_8411BCC8 = BattleAnim_UpdateCategoryCameraSequence;
func_84113E7C = BattleAnim_ConfigureGuardedCategoryCamera;
func_84114BF4 = BattleAnim_UpdateMoveTimeline;
func_8410D5CC = BattleAnim_AdjustCameraDistanceMild;
func_8410D9B8 = BattleAnim_AdjustCameraDistanceLowerBands;
func_8410DAC8 = BattleAnim_AdjustCameraDistanceStrong;
func_84122A0C = BattleAnim_UpdateTerrainPose;
func_84122EEC = BattleAnim_InitSignedRotatedMotion;
func_84123150 = BattleAnim_InitRotatedMotion;
func_841212A0 = BattleAnim_UpdateStagedTurn;
func_84121920 = BattleAnim_UpdateWideOscillation;
func_84123CF4 = BattleAnim_UpdateTimedOscillation;
func_84123F60 = BattleAnim_InitMovementByType;
func_84124104 = BattleAnim_UpdateMovementByType;
func_84123468 = BattleAnim_InitAuxiliaryGravityMotion;
func_84123664 = BattleAnim_UpdateAuxiliaryGravityMotion;
func_8412328C = BattleAnim_UpdateRotatedMotion;
func_84120700 = BattleAnim_InitActorFromActionFlags;
func_8620050C = SceneMotion_CreateThreeModels;
func_86201790 = SceneMotion_IsCrossXZNonnegative;
func_86203BA8 = SceneMotion_CopyNodePositionsToModels;
func_86203C58 = SceneMotion_RunSubsteps;
func_862009E4 = SceneCollision_TestBoundedPlaneHit;
func_86203DE8 = SceneFlags_MarkWhenCountsMatch;
func_86207D40 = Geometry_TestSphereContact;
func_86207F34 = Geometry_TestSegmentContact;
func_86207EB0 = Geometry_ComputePlaneParameter;
func_86207BC0 = Geometry_ComputeLineProjection;
func_86207A80 = Geometry_IsPointInTriangleXZ;
func_86207650 = SceneAux_UpdatePosition;
func_86207760 = SceneAux_RenderModel;
func_86207874 = SceneAux_CreateModels;
func_862079C0 = SceneAux_LoadResources;
func_86207280 = SceneModels_SelectAlternateAnimation;
func_862073CC = SceneModels_CreatePairs;
func_862067B4 = SceneMotion_ComputeNearbyDirection;
func_86206C34 = SceneInput_AdvanceSelectionPhase;
func_86206D20 = SceneInput_UpdateCpuSelection;
func_86206920 = SceneInput_SelectScoredDirection;
func_86205500 = SceneModel_InitPlayerAttachment;
func_86205B8C = SceneModel_StartPlayerAction;
func_86205C8C = SceneModel_SelectPlayerDirection;
func_86205D98 = SceneModel_UpdateAnimationState;
func_862057A8 = SceneMotion_RemoveInwardVelocity;
func_86205A7C = SceneMotion_ResolvePlayerContacts;
func_862061B0 = SceneModel_UpdateAnimatedPosition;
func_86205F34 = SceneModel_UpdateAlternateAnimation;
func_86206334 = SceneModel_InitPlayers;

func_8AB02F94 = TextReference_GetText;
func_8AB04BD4 = TextPanels_UpdateVisibility;
func_8AB03D10 = TextRow_SetOrangeState;
func_8AB0178C = TextNumber_DrawCallback;
func_8AB01850 = TextLabel_DrawCallback;
func_8AB01ED4 = TextPreview_InitializeModel;
func_8AB01FC8 = TextPreview_DrawRgba16Rect;
func_8AB02240 = TextPreview_DrawImage80;
func_8AB03ED4 = TextHighlight_AnimateScales;
func_8AB02A58 = TextReference_BuildShuffledRange;
func_8AB02438 = TextChoice_ShuffleAndRefresh;
func_8AB04C94 = TextInterface_DrawMarkers;
func_8AB02D14 = TextReference_BuildModeSelection;
func_8AB02644 = TextReference_BuildShuffledPairs;
func_8AB05300 = TextInterface_RunMainLoop;
func_8AB05538 = TextInterface_Run;
func_8AB0E350 = TextMode8_HandlePromptState;
func_8AB0D330 = TextMode8_InitCpuAnswerSettings;
func_8AB0D4BC = TextMode8_ChooseCpuAnswerMask;
func_8AB0F2F0 = TextMode8_HandleRowCleanupState;
func_8AB0DFC0 = TextMode8_UpdateState;
func_8AB0E0F4 = TextMode8_DrawState;
func_8AB0E8B4 = TextMode8_RevealPromptText;
func_8AB0E684 = TextMode8_HandlePrePromptState;
func_8AB0E9E8 = TextMode8_HandleAnswerInput;
func_81005B50 = DisplayList_BuildScrollingDualTexture;
func_81005DB4 = DisplayList_InitScrollingDualTexture;

/* Species-dependent particle emission. */
func_810045C4 = Particle31_UpdateSpeciesEffectTrigger;
func_81003F58 = Particle31_SpawnSpeciesEffect;
func_81005524 = Particle31_DisplayListCallback;

func_81004818 = Particle31_DrawAndUpdateSpeciesEffect;
